## esp32/components/muse/Kconfig
```kconfig
# Copyright (c) Meta Platforms, Inc. and affiliates.
#
# Licensed under the Apache License, Version 2.0 (the "License");
# you may not use this file except in compliance with the License.
# You may obtain a copy of the License at
#
#     http://www.apache.org/licenses/LICENSE-2.0
#
# Unless required by applicable law or agreed to in writing, software
# distributed under the License is distributed on an "AS IS" BASIS,
# WITHOUT WARRANTIES OR CONDITIONS OF ANY KIND, either express or implied.
# See the License for the specific language governing permissions and
# limitations under the License.
#
# Modified by ledienbien-ai (2026): added the Waveshare ESP32-S3-Touch-LCD-1.85C,
# the OSTB-3ST, the LCDWIKI 2.8inch ESP32-S3 Display, the startup logo, the
# Vietnamese screen and spoken replies.

menu "Muse"

    choice MUSE_BOARD
        prompt "Board with the full UI"
        default MUSE_BOARD_NONE
        help
            The UI is the voice companion on boards with a screen: an
            animated avatar, push-to-talk chat, settings, and battery
            handling. It runs beside Home Link, which owns Wi-Fi, BLE
            pairing, credentials and OTA. Pick the board it runs on, or none
            for a Link without a display.

        config MUSE_BOARD_NONE
            bool "None (Home Link without a display)"

        config MUSE_BOARD_WAVESHARE_S3_175C
            bool "Waveshare ESP32-S3-Touch-AMOLED-1.75C"
            depends on IDF_TARGET_ESP32S3

        config MUSE_BOARD_WAVESHARE_S3_175
            bool "Waveshare ESP32-S3-Touch-AMOLED-1.75 (not the 1.75C)"
            depends on IDF_TARGET_ESP32S3

        config MUSE_BOARD_WAVESHARE_S3_185C
            bool "Waveshare ESP32-S3-Touch-LCD-1.85C (round LCD, V1 or V2 audio)"
            depends on IDF_TARGET_ESP32S3

        config MUSE_BOARD_OSTB_3ST
            bool "OSTB-3ST (ESP32-S3, 1.83 inch touch LCD, two keys)"
            depends on IDF_TARGET_ESP32S3

        config MUSE_BOARD_LCDWIKI_S3_28
            bool "LCDWIKI 2.8inch ESP32-S3 Display (ES3C28P with touch, ES3N28P without)"
            depends on IDF_TARGET_ESP32S3

        config MUSE_BOARD_AIPI
            bool "AIPI Lite (ESP32-S3, two buttons, no touch)"
            depends on IDF_TARGET_ESP32S3

        config MUSE_BOARD_WAVESHARE_C6_18
            bool "Waveshare ESP32-C6-Touch-AMOLED-1.8"
            depends on IDF_TARGET_ESP32C6

        config MUSE_BOARD_SENSECAP_WATCHER
            bool "Seeed SenseCAP Watcher (ESP32-S3, round touch LCD, wheel)"
            depends on IDF_TARGET_ESP32S3

        config MUSE_BOARD_M5STACK_STICKS3
            bool "M5Stack StickS3 (ESP32-S3, two buttons, no touch)"
            depends on IDF_TARGET_ESP32S3

        config MUSE_BOARD_M5STACK_STICKC_PLUS2
            bool "M5Stack StickC Plus2 (ESP32, two buttons, no touch)"
            depends on IDF_TARGET_ESP32
    endchoice

    config MUSE_ENABLED
        bool
        default y if !MUSE_BOARD_NONE

    # Always defined, unlike the target-dependent board options, so
    # idf_component.yml rules can select each board's managed components.
    config MUSE_BOARD_ID
        string
        default "waveshare_s3_175c" if MUSE_BOARD_WAVESHARE_S3_175C
        default "waveshare_s3_175" if MUSE_BOARD_WAVESHARE_S3_175
        default "waveshare_s3_185c" if MUSE_BOARD_WAVESHARE_S3_185C
        default "ostb_3st" if MUSE_BOARD_OSTB_3ST
        default "lcdwiki_s3_28" if MUSE_BOARD_LCDWIKI_S3_28
        default "aipi" if MUSE_BOARD_AIPI
        default "waveshare_c6_18" if MUSE_BOARD_WAVESHARE_C6_18
        default "sensecap_watcher" if MUSE_BOARD_SENSECAP_WATCHER
        default "m5stack_sticks3" if MUSE_BOARD_M5STACK_STICKS3
        default "m5stack_stickc_plus2" if MUSE_BOARD_M5STACK_STICKC_PLUS2
        default "none"

    # The Muse tools' serial port: the console UART behind the board's USB
    # bridge, where the chip's own USB Serial/JTAG isn't wired to a connector
    # (the Watcher's USB-C goes to a CH342) or the chip has none.
    config MUSE_CONSOLE_UART
        bool
        default y if MUSE_BOARD_SENSECAP_WATCHER || !SOC_USB_SERIAL_JTAG_SUPPORTED

    config MUSE_WATCHER_CAMERA
        bool "SenseCAP Watcher camera capture and live preview"
        depends on MUSE_BOARD_SENSECAP_WATCHER && SPIRAM
        default n
        help
            Enable the camera.capture Home Link command and the wheel
            double-click camera preview. Camera buffers and tasks consume
            memory and preview decoding shares CPU time with voice and Link.
            Leave disabled to build without camera support.

    config MUSE_BOOT_LOGO
        bool "Show a logo while starting up"
        depends on MUSE_ENABLED
        default y
        help
            Shows the image in logo/logo.c on a black screen for the first
            moments after power-on, then the usual UI. The image is an LVGL
            image named "logo", as LVGL's image converter writes it; one
            larger than the screen is scaled down to fit. It takes its size
            in flash (170 KB for 240 x 240 in RGB565A8) and no RAM.

    config MUSE_BOOT_LOGO_MS
        int "How long the logo stays, in milliseconds"
        depends on MUSE_BOOT_LOGO
        range 500 10000
        default 2500

    config MUSE_LANG_DEFAULT_VI
        bool "Start in Vietnamese"
        depends on MUSE_ENABLED
        default n
        help
            The language of the screen until one is picked in Settings >
            Language (or with the "lang" setup command): Vietnamese with this
            on, English with it off. The choice is kept across restarts.
            Screens under 200 px stay in English: their fonts have no
            Vietnamese letters.

    config MUSE_HATCH
        bool "Muse's own voice session"
        depends on MUSE_ENABLED
        default y if SPIRAM
        default n
        help
            Push-to-talk turns go over a voice session of Muse's own, to the
            VM Home Link is paired with or one set up on the device with a
            device token. Replies are text, shown as captions, and spoken if
            "Speak replies" below is on. Needs PSRAM. Without it, voice notes
            go over Home Link's own session to its paired VM and replies are
            shown as text.

    config MUSE_TTS_GOOGLE
        bool "Speak replies with Google Translate's voice"
        depends on MUSE_HATCH
        default y
        help
            Muse answers gadgets in text. With this on and the speaker on, each
            reply is sent to the text-to-speech endpoint behind Google
            Translate's "listen" button and the MP3 it returns is played, in
            Vietnamese for a reply written in Vietnamese and otherwise in the
            screen's language. It needs no key, but it is not a published
            API: Google can change or block it at any time, it takes about 200
            characters a request, and the text of every spoken reply goes to
            Google. When it fails, the reply is shown at reading pace as
            before. Turn this off to keep replies as text, or put a service of
            your own in muse_tts.c.

endmenu
```
